## prebuilt/firmware/riscv/cr1825_multi.its
```
/*
 * U-Boot uImage source file with multiple kernels, ramdisks and FDT blobs
 */

/dts-v1/;

/ {
	description = "Various kernels, ramdisks and FDT blobs";
#address-cells = <2>;

	images {
		kernel-1 {
			description = "cvitek kernel zCore for cr1825";
			data = /incbin/("../../../zCore/zcore.bin");
			type = "kernel";
			arch = "riscv";
			os = "linux";
			compression = "none";
			load = <0x0 0x80200000>;
			entry = <0x0 0x80200000>;
			hash-2 {
				algo = "crc32";
			};
		};

		/*FDT*/
		fdt-cr1825_wevb_0007a_spinand {
			description = "cvitek device tree - cr1825_wevb_0007a_spinand";
			data = /incbin/("./cr1825_wevb_0007a_spinand.dtb");
			type = "flat_dt";
			arch = "riscv";
			compression = "none";
			hash-1 {
				algo = "sha256";
			};
		};

		fdt-cv1812h_wevb_0007a_emmc {
			description = "cvitek device tree - cv1812h_wevb_0007a_emmc";
			data = /incbin/("./cv1812h-fdt.dtb");
			type = "flat_dt";
			arch = "riscv";
			compression = "none";
			hash-1 {
				algo = "sha256";
			};
		};

		fdt-cv1811h_wevb_0007a_emmc {
			description = "cvitek device tree - cv1811h_wevb_0007a_emmc";
			data = /incbin/("./cv1811h-fdt.dtb");
			type = "flat_dt";
			arch = "riscv";
			compression = "none";
			hash-1 {
				algo = "sha256";
			};
		};

	};

	/*CFG*/
	configurations {
		default = "config-cv1811h_wevb_0007a_emmc";

		config-cr1825_wevb_0007a_spinand {
			description = "boot cvitek system with board cr1825_wevb_0007a_spinand";
			kernel = "kernel-1";
			fdt = "fdt-cr1825_wevb_0007a_spinand";
		};

		config-cv1812h_wevb_0007a_emmc {
			description = "boot cvitek system with board cv1812h_wevb_0007a_emmc";
			kernel = "kernel-1";
			fdt = "fdt-cv1812h_wevb_0007a_emmc";
		};

		config-cv1811h_wevb_0007a_emmc {
			description = "boot cvitek system with board cv1811h_wevb_0007a_emmc";
			kernel = "kernel-1";
			fdt = "fdt-cv1811h_wevb_0007a_emmc";
		};
	};

};
```

## prebuilt/firmware/riscv/fu740_fdt.its
```
/*
 * Simple U-Boot uImage source file containing a single kernel and FDT blob
 */

/dts-v1/;

/ {
	description = "Simple image with single zCore kernel and FDT blob for fu740";
	#address-cells = <1>;

	images {
		kernel {
			description = "zCore kernel for fu740";
			data = /incbin/("../../../zCore/zcore.bin.gz");
			type = "kernel";
			arch = "riscv";
			os = "linux";
			compression = "gzip";
			load = <0x80200000>;
			entry = <0x80200000>;
		};
		fdt-1 {
			description = "Flattened Device Tree blob";
			data = /incbin/("./hifive-unmatched-a00.dtb");
			type = "flat_dt";
			arch = "riscv";
			compression = "none";
		};
	};

	configurations {
		default = "conf-1";
		conf-1 {
			description = "Boot zCore kernel with FDT blob for fu740";
			kernel = "kernel";
			fdt = "fdt-1";
		};
	};
};
```

## prebuilt/firmware/riscv/starfive_fdt.its
```
/*
 * U-Boot uImage source file for "zCore-visionfive"
 */

/dts-v1/;

/ {
    description = "U-Boot uImage source file for zCore-visionfive";
    #address-cells = <1>;

    images {
        kernel {
            description = "Linux kernel for zCore-visionfive";
            data = /incbin/("../../../zcore.bin.gz");
            type = "kernel";
            arch = "riscv";
            os = "linux";
            compression = "gzip";
            load = <0x80200000>;
            entry = <0x80200000>;
        };
        fdt {
            description = "Flattened Device Tree blob for zCore-visionfive";
            data = /incbin/("./starfive.dtb");
            type = "flat_dt";
            arch = "riscv";
            compression = "none";
        };
    };

    configurations {
        default = "conf";
        conf {
            description = "Boot Linux kernel with FDT blob";
            kernel = "kernel";
            fdt = "fdt";
        };
    };
};
```
